## config/west.yml
```yaml
manifest:
  defaults:
    revision: v0.3
  remotes:
    - name: zmkfirmware
      url-base: https://github.com/zmkfirmware
    - name: keeb-it
      url-base: https://github.com/zmkfirmware
    - name: keeb-it
      url-base: https://github.com/keeb-it
  projects:
    - name: zmk
      remote: zmkfirmware
      import: app/west.yml

    - name: zmk
      remote: zmkfirmware
    


  self:
    path: config
```
